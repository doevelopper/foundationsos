## br2-foundationsos-external/Config.in
```kconfig
menu "FoundationsOS External Packages"

source "$BR2_EXTERNAL_FOUNDATIONSOS_PATH/package/rpi5-security-init/Config.in"
source "$BR2_EXTERNAL_FOUNDATIONSOS_PATH/package/rpi5-rauc-hawkbit/Config.in"

endmenu
```

## br2-foundationsos-external/package/applications/hello-autotools/Config.in
```kconfig
config BR2_PACKAGE_HELLO_AUTOTOOLS
	bool "hello-tools"
	help
	  This is an example of a package built with the autotools.
```

## br2-foundationsos-external/package/applications/hello-cmake/Config.in
```kconfig
config BR2_PACKAGE_HELLO_CMAKE
	bool "hello-cmake"
	help
	  This is an example of a package built with cmake.
```

## br2-foundationsos-external/package/applications/hello-makefile/Config.in
```kconfig
config BR2_PACKAGE_HELLO_MAKEFILE
	bool "hello-makefile"
	help
	  This is an example of a package built with a classic Makefile.
```

## br2-foundationsos-external/package/utils/btop/Config.in
```kconfig
config BR2_PACKAGE_BTOP
	bool "btop"
	depends on BR2_USE_MMU # atop
	depends on BR2_LINUX_KERNEL
	# kernel headers: >= 2.6.24
	select BR2_PACKAGE_ATOP2 # runtime
	select BR2_PACKAGE_ZLIB
	help
	  Resource monitor that shows usage and stats for processor, memory, disks, network and processes.

	  https://github.com/aristocratos/btop

comment "btop needs a Linux kernel >= 2.6.24 to be built"
	depends on BR2_USE_MMU
	depends on !BR2_LINUX_KERNEL
```

## br2-foundationsos-external/package/utils/cucumber-cpp/Config.in
```kconfig
config BR2_PACKAGE_CUCUMBER_CPP
	bool "cucumber_cpp"
	depends on BR2_INSTALL_LIBSTDCPP
	depends on BR2_LINUX_KERNEL
	select BR2_PACKAGE_GTEST
	select BR2_PACKAGE_RUBY
	select BR2_PACKAGE_BOOST
	select BR2_PACKAGE_BOOST_DATE_TIME
	select BR2_PACKAGE_BOOST_PROGRAM_OPTIONS
	select BR2_PACKAGE_BOOST_REGEX
	select BR2_PACKAGE_BOOST_THREAD

	help
	  C++ Behaviour Driven Development framework.

	  https://github.com/cucumber/cucumber-cpp
```

## br2-foundationsos-external/package/utils/home-persistence/Config.in
```kconfig
config BR2_PACKAGE_HOME_PERSISTENCE
	bool "home-persistence"
	select BR2_PACKAGE_PERSIST_PARTITION # runtime
	help
	  Fake package to save home (including shell history) across
	  reboots.
```

## br2-foundationsos-external/package/utils/netatop/Config.in
```kconfig
config BR2_PACKAGE_NETATOP
	bool "netatop"
	depends on BR2_USE_MMU # atop
	depends on BR2_LINUX_KERNEL
	# kernel headers: >= 2.6.24
	select BR2_PACKAGE_ATOP2 # runtime
	select BR2_PACKAGE_ZLIB
	help
	  The optional kernel module netatop can be loaded to gather
	  statistics about the TCP and UDP packets that have been
	  transmitted/received per process and per thread.

	  Netatop requires a Linux kernel >= 2.6.24 with the following
	  option enabled:

	  - CONFIG_NETFILTER

	  http://www.atoptool.nl/netatop.php

comment "netatop needs a Linux kernel >= 2.6.24 to be built"
	depends on BR2_USE_MMU
	depends on !BR2_LINUX_KERNEL
```

## br2-foundationsos-external/package/utils/persist-partition/Config.in
```kconfig
config BR2_PACKAGE_PERSIST_PARTITION
	bool "persist-partition"
	help
	  Fake package to mount partition to save data across reboots.
```

## br2-foundationsos-external/package/utils/ssh-key-persistence/Config.in
```kconfig
config BR2_PACKAGE_SSH_KEY_PERSISTENCE
	bool "ssh-key-persistence"
	select BR2_PACKAGE_OPENSSH # runtime
	select BR2_PACKAGE_PERSIST_PARTITION # runtime
	select BR2_PACKAGE_RSYNC # runtime
	help
	  Fake package to save ssh keys between reboots and updates.
```

## br2-foundationsos-external/package/utils/ssh-root-password/Config.in
```kconfig
config BR2_PACKAGE_SSH_ROOT_PASSWORD
	bool "ssh-root-password"
	select BR2_PACKAGE_OPENSSH # runtime
	help
	  Fake package to enable root login using ssh.
	  WARNING: INSECURE, do not use for real projects

comment "WARNING: accepting ssh connection from user root is INSECURE, do not use for real projects"
	depends on BR2_PACKAGE_SSH_ROOT_PASSWORD
```

## configs/raspberrypi3bp_defconfig
```kconfig
# FoundationsOS Buildroot defconfig — Raspberry Pi 3 Model B+ (BCM2837, AArch64)
#
# v0.6.0 — IMA/EVM full enforcement (signed file hashes + EVM HMAC).
#
# Security stack included at this milestone:
#   - ARM Trusted Firmware-A BL31 (EL3 secure monitor, loaded as armstub)
#   - OP-TEE OS BL32 (S-EL1 Trusted Execution Environment)
#   - Hardened Linux kernel (security fragment on top of multi_v8 defconfig)
#   - TPM 2.0 userspace stack (tpm2-tss, tpm2-tools, tpm2-abrmd)
#   - RAUC A/B atomic OTA update framework
#   - systemd init with hardened service units
#   - IMA/EVM full enforcement: RSA-4096 signed file hashes + EVM HMAC
#   - dm-crypt / LUKS2 encrypted storage (TPM-sealed key)
#   - AppArmor MAC, seccomp, kernel lockdown
#
# Boot chain (EL levels):
#   VideoCore firmware → bl31.bin (TF-A BL31 armstub, EL3) → OP-TEE (BL32, S-EL1)
#                      → U-Boot (BL33, EL2) → Linux kernel (EL1)
#
# Constraints vs RPi5:
#   - Cortex-A53 (ARMv8-A) — no SVE, no LSE atomics
#   - 1 GiB RAM — keep rootfs footprint lean; OP-TEE TZDRAM_BASE carefully set
#   - UART0 shared with Bluetooth — dtoverlay=disable-bt required
#
# Deferred to later milestones:
#   - TPM measured boot via U-Boot (v0.3.0)
#
# Build:
#   make configure BOARD=raspberrypi3bp
#   make build     BOARD=raspberrypi3bp

# ─── Architecture ──────────────────────────────────────────────────────────────
BR2_aarch64=y
BR2_cortex_a53=y

# ─── Toolchain ─────────────────────────────────────────────────────────────────
BR2_TOOLCHAIN_BUILDROOT_GLIBC=y
BR2_TOOLCHAIN_BUILDROOT_CXX=y
BR2_GCC_VERSION_13_X=y
BR2_BINUTILS_VERSION_2_41_X=y
BR2_TOOLCHAIN_BUILDROOT_FORTIFY_SOURCE=y
BR2_TOOLCHAIN_BUILDROOT_SSP=y
BR2_TOOLCHAIN_BUILDROOT_RELRO=y

# ─── System ────────────────────────────────────────────────────────────────────
BR2_TARGET_GENERIC_HOSTNAME="foundationsos"
BR2_TARGET_GENERIC_ISSUE="FoundationsOS v0.2.0 - Secured Embedded Linux"
BR2_TARGET_GENERIC_ROOT_PASSWD=""
BR2_INIT_SYSTEMD=y
BR2_SYSTEM_DHCP="eth0"
BR2_TARGET_TZ_INFO=y
BR2_ENABLE_LOCALE=y

# ─── Linux Kernel ──────────────────────────────────────────────────────────────
BR2_LINUX_KERNEL=y
BR2_LINUX_KERNEL_LATEST_VERSION=y
BR2_LINUX_KERNEL_USE_DEFCONFIG=y
BR2_LINUX_KERNEL_DEFCONFIG="multi_v8"
BR2_LINUX_KERNEL_CONFIG_FRAGMENT_FILES="board/raspberrypi3bp/linux-hardened.config"
BR2_LINUX_KERNEL_DTS_SUPPORT=y
BR2_LINUX_KERNEL_INTREE_DTS_NAME="broadcom/bcm2837-rpi-3-b-plus"
BR2_LINUX_KERNEL_NEEDS_HOST_OPENSSL=y
BR2_LINUX_KERNEL_IMAGE_TARGET_NAME="Image"

# ─── Bootloader (U-Boot) ───────────────────────────────────────────────────────
# U-Boot acts as BL33 (Normal World bootloader) in the TF-A boot chain.
BR2_TARGET_UBOOT=y
BR2_TARGET_UBOOT_BUILD_SYSTEM_KCONFIG=y
BR2_TARGET_UBOOT_VERSION="2024.01"
BR2_TARGET_UBOOT_BOARD_DEFCONFIG="rpi_arm64"
BR2_TARGET_UBOOT_CONFIG_FRAGMENT_FILES="board/raspberrypi3bp/uboot-tpm.config"
BR2_TARGET_UBOOT_NEEDS_DTC=y

# ─── ARM Trusted Firmware-A (BL31 — EL3 Secure Monitor) ──────────────────────
# On RPi3/BCM2837, the VideoCore firmware loads bl31.bin as an "armstub"
# (armstub=bl31.bin in config.txt) before the main kernel/U-Boot. The armstub
# is entered at EL3 and initialises the secure world.
#
# RPI3_PRELOADED_DTB_BASE: address where the firmware places the DTB blob so
# TF-A can pass it to U-Boot / Linux. 0x2eff8000 is the standard RPi3 value.
# LOG_LEVEL=20 (NOTICE) — suitable for production builds.
BR2_TARGET_ARM_TRUSTED_FIRMWARE=y
BR2_TARGET_ARM_TRUSTED_FIRMWARE_LATEST_VERSION=y
BR2_TARGET_ARM_TRUSTED_FIRMWARE_PLATFORM="rpi3"
BR2_TARGET_ARM_TRUSTED_FIRMWARE_UBOOT_AS_BL33=y
BR2_TARGET_ARM_TRUSTED_FIRMWARE_BL31=y
BR2_TARGET_ARM_TRUSTED_FIRMWARE_ADDITIONAL_VARIABLES="AARCH64_SP=optee LOG_LEVEL=20 RPI3_PRELOADED_DTB_BASE=0x2eff8000"

# ─── OP-TEE OS (BL32 — S-EL1 Trusted Execution Environment) ──────────────────
# CFG_ARM64_core=y: compile a 64-bit (AArch64) TEE core for Cortex-A53.
# CFG_TZDRAM_START / CFG_TZDRAM_SIZE: carve 16 MiB of TrustZone DRAM from the
# top of physical RAM (1 GiB - 16 MiB = 0x3f000000).
BR2_TARGET_OPTEE_OS=y
BR2_TARGET_OPTEE_OS_LATEST_VERSION=y
BR2_TARGET_OPTEE_OS_PLATFORM="rpi3"
BR2_TARGET_OPTEE_OS_ADDITIONAL_VARIABLES="CFG_ARM64_core=y CFG_TEE_CORE_LOG_LEVEL=2 CFG_TZDRAM_START=0x3f000000 CFG_TZDRAM_SIZE=0x01000000 CFG_WITH_STMM_SP=n CFG_RPMB_FS=n"

# ─── Raspberry Pi VideoCore Firmware ──────────────────────────────────────────
# Provides: start.elf, fixup.dat, bootcode.bin, overlays/
BR2_PACKAGE_RPI_FIRMWARE=y

# ─── OP-TEE Client (Normal World TEE driver userspace) ────────────────────────
# Provides: tee-supplicant (REE-side daemon), libteec (TA invocation API),
# libckteec (PKCS#11 token interface).
BR2_PACKAGE_OPTEE_CLIENT=y
BR2_PACKAGE_OPTEE_CLIENT_SUPPLICANT=y

# ─── TPM 2.0 ───────────────────────────────────────────────────────────────────
BR2_PACKAGE_TPM2_TSS=y
BR2_PACKAGE_TPM2_TSS_FAPI=y
BR2_PACKAGE_TPM2_TOOLS=y
BR2_PACKAGE_TPM2_ABRMD=y

# ─── RAUC ──────────────────────────────────────────────────────────────────────
BR2_PACKAGE_RAUC=y
BR2_PACKAGE_RAUC_STREAMING=y
BR2_PACKAGE_HOST_RAUC=y
BR2_PACKAGE_RAUC_HAWKBIT_UPDATER=y

# ─── Filesystem / Encryption ───────────────────────────────────────────────────
BR2_PACKAGE_CRYPTSETUP=y
BR2_PACKAGE_LVM2=y
BR2_PACKAGE_E2FSPROGS=y
BR2_PACKAGE_DOSFSTOOLS=y
BR2_PACKAGE_UTIL_LINUX=y
BR2_PACKAGE_UTIL_LINUX_BINARIES=y

# ─── Security Tools ────────────────────────────────────────────────────────────
BR2_PACKAGE_OPENSSL=y
BR2_PACKAGE_WOLFSSL=y
BR2_PACKAGE_MBEDTLS=y
BR2_PACKAGE_LIBSECCOMP=y
BR2_PACKAGE_ATTR=y
BR2_PACKAGE_KEYUTILS=y
BR2_PACKAGE_IMA_EVM_UTILS=y

# ─── systemd ───────────────────────────────────────────────────────────────────
BR2_PACKAGE_SYSTEMD=y
BR2_PACKAGE_SYSTEMD_JOURNAL=y
BR2_PACKAGE_SYSTEMD_RESOLVED=y
BR2_PACKAGE_SYSTEMD_NETWORKD=y
BR2_PACKAGE_SYSTEMD_TIMESYNCD=y
BR2_PACKAGE_SYSTEMD_COREDUMP=y
BR2_PACKAGE_SYSTEMD_SECCOMP=y

# ─── Networking ────────────────────────────────────────────────────────────────
BR2_PACKAGE_OPENSSH=y
BR2_PACKAGE_IPTABLES=y
BR2_PACKAGE_NFTABLES=y
BR2_PACKAGE_WPA_SUPPLICANT=y

# ─── Utilities ─────────────────────────────────────────────────────────────────
BR2_PACKAGE_BUSYBOX=y
BR2_PACKAGE_UTIL_LINUX=y
BR2_PACKAGE_PROCPS_NG=y
BR2_PACKAGE_STRACE=y
BR2_PACKAGE_LSOF=y

# ─── Filesystem Images ─────────────────────────────────────────────────────────
BR2_TARGET_ROOTFS_EXT2=y
BR2_TARGET_ROOTFS_EXT2_4=y
BR2_TARGET_ROOTFS_EXT2_SIZE="512M"
BR2_TARGET_ROOTFS_SQUASHFS=y

# ─── Board Files ───────────────────────────────────────────────────────────────
BR2_ROOTFS_OVERLAY="board/raspberrypi3bp/rootfs_overlay"
BR2_ROOTFS_POST_BUILD_SCRIPT="board/raspberrypi3bp/post-build.sh"
BR2_ROOTFS_POST_IMAGE_SCRIPT="board/raspberrypi3bp/post-image.sh"
```
