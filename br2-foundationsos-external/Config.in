## configs/raspberrypi5_defconfig
```kconfig
# FoundationsOS Buildroot defconfig — Raspberry Pi 5 (BCM2712)
#
# v0.7.0 — AppArmor MAC profiles for all system services.
#
# Security stack included at this milestone:
#   - ARM Trusted Firmware-A BL31 (EL3 secure monitor, armstub)
#   - OP-TEE OS BL32 (S-EL1 Trusted Execution Environment)
#   - Hardened Linux kernel (security fragment on top of multi_v8 defconfig)
#   - TPM 2.0 userspace stack (tpm2-tss, tpm2-tools, tpm2-abrmd)
#   - RAUC A/B atomic OTA update framework
#   - systemd init with hardened service units
#   - IMA/EVM full enforcement: RSA-4096 signed file hashes + EVM HMAC
#   - dm-crypt / LUKS2 encrypted storage (TPM-sealed key)
#   - AppArmor MAC profiles enforced for all system services
#
# Boot chain (EL levels):
#   VideoCore firmware → bl31.bin (TF-A BL31, EL3) → OP-TEE (BL32, S-EL1)
#                      → U-Boot (BL33, EL2) → Linux kernel (EL1)
#
# Deferred to later milestones:
#   - TPM measured boot via U-Boot (v0.3.0)
#   - Full disk encryption with sealed LUKS key (v0.5.0)
#
# Build:
#   make configure BOARD=raspberrypi5
#   make build     BOARD=raspberrypi5

# ─── Architecture ──────────────────────────────────────────────────────────────
BR2_aarch64=y
BR2_cortex_a76=y

# ─── Toolchain ─────────────────────────────────────────────────────────────────
BR2_TOOLCHAIN_BUILDROOT_GLIBC=y
BR2_TOOLCHAIN_BUILDROOT_CXX=y
BR2_GCC_VERSION_13_X=y
BR2_BINUTILS_VERSION_2_41_X=y
BR2_TOOLCHAIN_BUILDROOT_FORTIFY_SOURCE=y
BR2_TOOLCHAIN_BUILDROOT_SSP=y
BR2_TOOLCHAIN_BUILDROOT_RELRO=y

# ─── System ────────────────────────────────────────────────────────────────────
BR2_TARGET_GENERIC_HOSTNAME="foundationsos"
BR2_TARGET_GENERIC_ISSUE="FoundationsOS v0.2.0 - Secured Embedded Linux"
BR2_TARGET_GENERIC_ROOT_PASSWD=""
BR2_INIT_SYSTEMD=y
BR2_SYSTEM_DHCP="eth0"
BR2_TARGET_TZ_INFO=y
BR2_ENABLE_LOCALE=y

# ─── Linux Kernel ──────────────────────────────────────────────────────────────
BR2_LINUX_KERNEL=y
BR2_LINUX_KERNEL_LATEST_VERSION=y
# Use the upstream multi-platform AArch64 defconfig as the base and apply
# our security hardening fragment on top.
BR2_LINUX_KERNEL_USE_DEFCONFIG=y
BR2_LINUX_KERNEL_DEFCONFIG="multi_v8"
BR2_LINUX_KERNEL_CONFIG_FRAGMENT_FILES="board/raspberrypi5/linux-hardened.config"
BR2_LINUX_KERNEL_DTS_SUPPORT=y
BR2_LINUX_KERNEL_INTREE_DTS_NAME="broadcom/bcm2712-rpi-5-b"
BR2_LINUX_KERNEL_NEEDS_HOST_OPENSSL=y
BR2_LINUX_KERNEL_IMAGE_TARGET_NAME="Image"

# ─── Bootloader (U-Boot) ───────────────────────────────────────────────────────
# rpi_arm64_defconfig covers all 64-bit Raspberry Pi boards, including RPi5.
# U-Boot acts as BL33 (Normal World bootloader) in the TF-A boot chain.
BR2_TARGET_UBOOT=y
BR2_TARGET_UBOOT_BUILD_SYSTEM_KCONFIG=y
BR2_TARGET_UBOOT_VERSION="2024.01"
BR2_TARGET_UBOOT_BOARD_DEFCONFIG="rpi_arm64"
BR2_TARGET_UBOOT_CONFIG_FRAGMENT_FILES="board/raspberrypi5/uboot-tpm.config"
BR2_TARGET_UBOOT_NEEDS_DTC=y

# ─── ARM Trusted Firmware-A (BL31 — EL3 Secure Monitor) ──────────────────────
# TF-A runs at EL3 and is loaded by the VideoCore firmware as an armstub
# (armstub=bl31.bin in config.txt). It initialises the secure world, hands
# off to OP-TEE (BL32, S-EL1), then boots U-Boot (BL33, EL2/NS-EL1).
#
# Platform "rpi5" was added in TF-A 2.9. LOG_LEVEL=20 (NOTICE) for production.
# AARCH64_SP=optee: use OP-TEE as the Secure Payload Dispatcher (SPD).
BR2_TARGET_ARM_TRUSTED_FIRMWARE=y
BR2_TARGET_ARM_TRUSTED_FIRMWARE_LATEST_VERSION=y
BR2_TARGET_ARM_TRUSTED_FIRMWARE_PLATFORM="rpi5"
BR2_TARGET_ARM_TRUSTED_FIRMWARE_UBOOT_AS_BL33=y
BR2_TARGET_ARM_TRUSTED_FIRMWARE_BL31=y
BR2_TARGET_ARM_TRUSTED_FIRMWARE_ADDITIONAL_VARIABLES="AARCH64_SP=optee LOG_LEVEL=20 PLAT_RPI_TRUSTED_SRAM_SIZE=0x40000"

# ─── OP-TEE OS (BL32 — S-EL1 Trusted Execution Environment) ──────────────────
# OP-TEE provides the TEE (Trusted Execution Environment) for secure storage,
# key management, and Trusted Applications (TAs).
# CFG_ARM64_core=y: AArch64 TEE core (mandatory for RPi5 / Cortex-A76).
# CFG_TEE_CORE_LOG_LEVEL=2: INFO logging (reduce to 0 for production).
# CFG_WITH_STMM_SP=n: no StandaloneMM (not needed at this milestone).
BR2_TARGET_OPTEE_OS=y
BR2_TARGET_OPTEE_OS_LATEST_VERSION=y
BR2_TARGET_OPTEE_OS_PLATFORM="rpi5"
BR2_TARGET_OPTEE_OS_ADDITIONAL_VARIABLES="CFG_ARM64_core=y CFG_TEE_CORE_LOG_LEVEL=2 CFG_WITH_STMM_SP=n CFG_RPMB_FS=n"

# ─── Raspberry Pi VideoCore Firmware ──────────────────────────────────────────
# Provides: start4.elf, fixup4.dat, bootcode.bin, overlays/
BR2_PACKAGE_RPI_FIRMWARE=y
BR2_PACKAGE_RPI_FIRMWARE_VARIANT_PI4=y

# ─── OP-TEE Client (Normal World TEE driver userspace) ────────────────────────
# Provides: tee-supplicant (REE-side daemon), libteec (TA invocation API),
# libckteec (PKCS#11 token interface), pkcs11 TA shim.
BR2_PACKAGE_OPTEE_CLIENT=y
BR2_PACKAGE_OPTEE_CLIENT_SUPPLICANT=y

# ─── TPM 2.0 ───────────────────────────────────────────────────────────────────
# SPI TPM (e.g. Infineon SLB9670) via dtoverlay=tpm-slb9670 in config.txt.
# Full measured boot integration deferred to v0.3.0.
BR2_PACKAGE_TPM2_TSS=y
BR2_PACKAGE_TPM2_TSS_FAPI=y
BR2_PACKAGE_TPM2_TOOLS=y
BR2_PACKAGE_TPM2_ABRMD=y

# ─── RAUC ──────────────────────────────────────────────────────────────────────
BR2_PACKAGE_RAUC=y
BR2_PACKAGE_RAUC_STREAMING=y
BR2_PACKAGE_HOST_RAUC=y
BR2_PACKAGE_RAUC_HAWKBIT_UPDATER=y

# ─── Filesystem / Encryption ───────────────────────────────────────────────────
BR2_PACKAGE_CRYPTSETUP=y
BR2_PACKAGE_LVM2=y
BR2_PACKAGE_E2FSPROGS=y
BR2_PACKAGE_DOSFSTOOLS=y
# LUKS v0.5.0: wipefs (util-linux) needed for partition detection
BR2_PACKAGE_UTIL_LINUX=y
BR2_PACKAGE_UTIL_LINUX_BINARIES=y

# ─── Security Tools ────────────────────────────────────────────────────────────
BR2_PACKAGE_OPENSSL=y
BR2_PACKAGE_WOLFSSL=y
BR2_PACKAGE_MBEDTLS=y
BR2_PACKAGE_LIBSECCOMP=y
BR2_PACKAGE_ATTR=y
BR2_PACKAGE_KEYUTILS=y
BR2_PACKAGE_IMA_EVM_UTILS=y
# AppArmor v0.7.0: userspace tools for profile loading and management
BR2_PACKAGE_APPARMOR=y

# ─── systemd ───────────────────────────────────────────────────────────────────
BR2_PACKAGE_SYSTEMD=y
BR2_PACKAGE_SYSTEMD_JOURNAL=y
BR2_PACKAGE_SYSTEMD_RESOLVED=y
BR2_PACKAGE_SYSTEMD_NETWORKD=y
BR2_PACKAGE_SYSTEMD_TIMESYNCD=y
BR2_PACKAGE_SYSTEMD_COREDUMP=y
BR2_PACKAGE_SYSTEMD_SECCOMP=y

# ─── Networking ────────────────────────────────────────────────────────────────
BR2_PACKAGE_OPENSSH=y
BR2_PACKAGE_IPTABLES=y
BR2_PACKAGE_NFTABLES=y
BR2_PACKAGE_WPA_SUPPLICANT=y

# ─── Utilities ─────────────────────────────────────────────────────────────────
BR2_PACKAGE_BUSYBOX=y
BR2_PACKAGE_UTIL_LINUX=y
BR2_PACKAGE_PROCPS_NG=y
BR2_PACKAGE_STRACE=y
BR2_PACKAGE_LSOF=y

# ─── Filesystem Images ─────────────────────────────────────────────────────────
BR2_TARGET_ROOTFS_EXT2=y
BR2_TARGET_ROOTFS_EXT2_4=y
BR2_TARGET_ROOTFS_EXT2_SIZE="512M"
BR2_TARGET_ROOTFS_SQUASHFS=y

# ─── Board Files ───────────────────────────────────────────────────────────────
BR2_ROOTFS_OVERLAY="board/raspberrypi5/rootfs_overlay"
BR2_ROOTFS_POST_BUILD_SCRIPT="board/raspberrypi5/post-build.sh"
BR2_ROOTFS_POST_IMAGE_SCRIPT="board/raspberrypi5/post-image.sh"
```

## external/package/rpi5-rauc-hawkbit/Config.in
```kconfig
config BR2_PACKAGE_RPI5_RAUC_HAWKBIT
bool "rpi5-rauc-hawkbit"
depends on BR2_PACKAGE_RAUC
depends on BR2_PACKAGE_RAUC_HAWKBIT_UPDATER
help
  FoundationsOS RAUC hawkBit integration package.
  Installs the hawkBit OTA updater configuration for
  secure over-the-air updates via an Eclipse hawkBit server.
```

## external/package/rpi5-security-init/Config.in
```kconfig
config BR2_PACKAGE_RPI5_SECURITY_INIT
    bool "rpi5-security-init"
    depends on BR2_INIT_SYSTEMD
    depends on BR2_PACKAGE_TPM2_TOOLS
    help
      First-boot TPM 2.0 provisioning and platform attestation
      initialization service for Raspberry Pi 5.

      Performs:
        - TPM ownership taking and EK certificate provisioning
        - AIK (Attestation Identity Key) generation
        - Initial PCR policy sealing
        - Disk encryption key unsealing
```
