## br2-foundationsos-external/configs/foundation5_defconfig
```kconfig
BR2_aarch64=y
BR2_cortex_a76=y
BR2_TOOLCHAIN_EXTERNAL=y
BR2_TOOLCHAIN_EXTERNAL_BOOTLIN=y
BR2_GLOBAL_PATCH_DIR="$(BR2_EXTERNAL_FOUNDATIONSOS_PATH)/board/foundation5/patches"
BR2_DOWNLOAD_FORCE_CHECK_HASHES=y
BR2_TARGET_GENERIC_HOSTNAME="FoundationsOS"
BR2_TARGET_GENERIC_ISSUE="FoundationsOS 0.0.0+unknown - Secured Embedded Linux 5"
BR2_TARGET_GENERIC_PASSWD_SHA512=y
BR2_INIT_SYSTEMD=y
BR2_SYSTEM_BIN_SH_BASH=y
BR2_SYSTEM_DHCP="eth0"
BR2_SYSTEM_DEFAULT_PATH="/bin:/sbin:/usr/bin:/usr/sbin"
BR2_ROOTFS_USERS_TABLES="$(BR2_EXTERNAL_FOUNDATIONSOS_PATH)/board/common/user-table.conf"
BR2_ROOTFS_PRE_BUILD_SCRIPT="$(BR2_EXTERNAL_FOUNDATIONSOS_PATH)/board/common/pre-build.sh"
BR2_ROOTFS_POST_BUILD_SCRIPT="$(BR2_EXTERNAL_FOUNDATIONSOS_PATH)/board/common/post-build.sh $(BR2_EXTERNAL_FOUNDATIONSOS_PATH)/board/foundation5/post-build.sh"
BR2_ROOTFS_POST_FAKEROOT_SCRIPT="$(BR2_EXTERNAL_FOUNDATIONSOS_PATH)/board/common/post-fakeroot.sh"
BR2_ROOTFS_POST_IMAGE_SCRIPT="$(BR2_EXTERNAL_FOUNDATIONSOS_PATH)/board/common/post-image.sh $(BR2_EXTERNAL_FOUNDATIONSOS_PATH)/board/foundation5/post-image.sh"
BR2_ROOTFS_POST_SCRIPT_ARGS="--board-gen=5"
BR2_LINUX_KERNEL=y
BR2_LINUX_KERNEL_CUSTOM_TARBALL=y
BR2_LINUX_KERNEL_CUSTOM_TARBALL_LOCATION="$(call github,raspberrypi,linux,21b410140c47ffab5668399f6f143c7d7b935c8b)/linux-21b410140c47ffab5668399f6f143c7d7b935c8b.tar.gz"
BR2_LINUX_KERNEL_USE_CUSTOM_CONFIG=y
BR2_LINUX_KERNEL_CUSTOM_CONFIG_FILE="$(BR2_EXTERNAL_FOUNDATIONSOS_PATH)/board/foundation5/linux-hardened.config"
BR2_LINUX_KERNEL_CONFIG_FRAGMENT_FILES="$(BR2_EXTERNAL_FOUNDATIONSOS_PATH)/board/foundation5/linux-4k-page-size.fragment"
BR2_LINUX_KERNEL_DTS_SUPPORT=y
BR2_LINUX_KERNEL_INTREE_DTS_NAME="broadcom/bcm2712-rpi-5-b broadcom/bcm2712d0-rpi-5-b broadcom/bcm2712-rpi-500"
BR2_LINUX_KERNEL_NEEDS_HOST_OPENSSL=y
BR2_PACKAGE_XZ=y
BR2_PACKAGE_DOSFSTOOLS=y
BR2_PACKAGE_E2FSPROGS=y
BR2_PACKAGE_RPI_FIRMWARE=y
BR2_PACKAGE_RPI_FIRMWARE_CONFIG_FILE="$(BR2_EXTERNAL_FOUNDATIONSOS_PATH)/board/foundation5/config_5.txt"
BR2_PACKAGE_RPI_FIRMWARE_CMDLINE_FILE="$(BR2_EXTERNAL_FOUNDATIONSOS_PATH)/board/foundation5/cmdline_5.txt"
# BR2_PACKAGE_RPI_FIRMWARE_INSTALL_DTB_OVERLAYS is not set
BR2_PACKAGE_CRYPTSETUP=y
BR2_PACKAGE_GPTFDISK=y
BR2_PACKAGE_GPTFDISK_GDISK=y
BR2_PACKAGE_GPTFDISK_SGDISK=y
BR2_PACKAGE_LIBSECCOMP=y
BR2_PACKAGE_NCURSES_WCHAR=y
BR2_PACKAGE_APPARMOR=y
BR2_PACKAGE_APPARMOR_BINUTILS=y
BR2_PACKAGE_APPARMOR_PROFILES=y
BR2_PACKAGE_IMA_EVM_UTILS=y
BR2_PACKAGE_OPTEE_CLIENT_TEEACL=y
BR2_PACKAGE_OPTEE_EXAMPLES=y
BR2_PACKAGE_OPTEE_TEST=y
BR2_PACKAGE_ATTR=y
BR2_PACKAGE_RAUC_DBUS=y
BR2_PACKAGE_RAUC_NETWORK=y
BR2_PACKAGE_RAUC_STREAMING=y
BR2_PACKAGE_RAUC_JSON=y
BR2_PACKAGE_RAUC_HAWKBIT_UPDATER=y
BR2_PACKAGE_SYSTEMD_COREDUMP=y
BR2_PACKAGE_TPM2_ABRMD=y
BR2_PACKAGE_TPM2_TOOLS=y
BR2_PACKAGE_TPM2_TOOLS_FAPI=y
BR2_PACKAGE_TPM2_TOTP=y
BR2_PACKAGE_UTIL_LINUX_LIBFDISK=y
BR2_TARGET_ROOTFS_EXT2=y
BR2_TARGET_ROOTFS_EXT2_4=y
BR2_TARGET_ROOTFS_EXT2_SIZE="512M"
BR2_TARGET_ROOTFS_SQUASHFS=y
# BR2_TARGET_ROOTFS_TAR is not set
BR2_TARGET_ARM_TRUSTED_FIRMWARE=y
BR2_TARGET_ARM_TRUSTED_FIRMWARE_LATEST_LTS_2_12_VERSION=y
BR2_TARGET_ARM_TRUSTED_FIRMWARE_PLATFORM="rpi5"
BR2_TARGET_ARM_TRUSTED_FIRMWARE_UBOOT_AS_BL33=y
BR2_TARGET_ARM_TRUSTED_FIRMWARE_ADDITIONAL_VARIABLES="AARCH64_SP=optee LOG_LEVEL=20 PLAT_RPI_TRUSTED_SRAM_SIZE=0x40000"
BR2_TARGET_OPTEE_OS=y
BR2_TARGET_OPTEE_OS_PLATFORM="rpi5"
BR2_TARGET_OPTEE_OS_ADDITIONAL_VARIABLES="CFG_ARM64_core=y CFG_TEE_CORE_LOG_LEVEL=2 CFG_WITH_STMM_SP=n CFG_RPMB_FS=n"
BR2_TARGET_UBOOT=y
BR2_TARGET_UBOOT_USE_CUSTOM_CONFIG=y
BR2_TARGET_UBOOT_CUSTOM_CONFIG_FILE="$(BR2_EXTERNAL_FOUNDATIONSOS_PATH)/board/foundation5/uboot-hardened.config"
BR2_TARGET_UBOOT_CONFIG_FRAGMENT_FILES="$(BR2_EXTERNAL_FOUNDATIONSOS_PATH)/board/foundation5/uboot-tpm.config"
BR2_TARGET_UBOOT_NEEDS_GNUTLS=y
BR2_PACKAGE_HOST_DOSFSTOOLS=y
BR2_PACKAGE_HOST_GENIMAGE=y
BR2_PACKAGE_HOST_KMOD_XZ=y
BR2_PACKAGE_HOST_MTOOLS=y
BR2_PACKAGE_HOST_RAUC=y
```

## br2-foundationsos-external/package/Config.in
```kconfig
# FoundationsOS External Packages Configuration Menu
# This file sources all available custom packages organized by category

menu "FoundationsOS Custom Packages"

source "$BR2_EXTERNAL_FOUNDATIONSOS_PATH/package/applications/Config.in"

source "$BR2_EXTERNAL_FOUNDATIONSOS_PATH/package/drivers/Config.in"

source "$BR2_EXTERNAL_FOUNDATIONSOS_PATH/package/utils/Config.in"

comment "Security & OTA Packages"
source "$BR2_EXTERNAL_FOUNDATIONSOS_PATH/package/rpi5-security-init/Config.in"
source "$BR2_EXTERNAL_FOUNDATIONSOS_PATH/package/rpi5-rauc-hawkbit/Config.in"

comment "System Packages"
source "$BR2_EXTERNAL_FOUNDATIONSOS_PATH/package/ucos-opkg/Config.in"
source "$BR2_EXTERNAL_FOUNDATIONSOS_PATH/package/unipi-kernel-modules/Config.in"
source "$BR2_EXTERNAL_FOUNDATIONSOS_PATH/package/zsh-autosuggestions/Config.in"
source "$BR2_EXTERNAL_FOUNDATIONSOS_PATH/package/zsh-history-substring-search/Config.in"

endmenu
```

## br2-foundationsos-external/package/applications/Config.in
```kconfig
# FoundationsOS Application Packages
# Development and example applications

comment "Applications (Examples & Development)"

config BR2_PACKAGE_HELLO_MAKEFILE
	bool "hello-makefile"
	help
	  Example application built with a classic Makefile.
	  Source: https://www.blaess.fr/christophe/yocto-lab/

config BR2_PACKAGE_HELLO_CMAKE
	bool "hello-cmake"
	help
	  Example application built with CMake.
	  Source: https://www.blaess.fr/christophe/yocto-lab/

config BR2_PACKAGE_HELLO_AUTOTOOLS
	bool "hello-autotools"
	help
	  Example application built with Autotools.
	  Source: https://www.blaess.fr/christophe/yocto-lab/

config BR2_PACKAGE_HELLOWORLD
	bool "helloworld"
	help
	  Simple hello world example application.

config BR2_PACKAGE_GPIO
	bool "gpio"
	help
	  GPIO control application example.

config BR2_PACKAGE_TIMER
	bool "timer"
	help
	  Timer utility example application.

config BR2_PACKAGE_CPPBDD101
	bool "cppbdd101"
	help
	  C++ Behavior Driven Development example.

config BR2_PACKAGE_TEMPLATE_C
	bool "template-c"
	help
	  C language project template.

config BR2_PACKAGE_TEMPLATE_CPP
	bool "template-cpp"
	help
	  C++ language project template.

config BR2_PACKAGE_TEMPLATE_PY
	bool "template-py"
	help
	  Python language project template.
```

## br2-foundationsos-external/package/applications/cppbdd101/Config.in
```kconfig
config BR2_PACKAGE_CPPBDD101
	bool "cppbdd101"
	help
	  C++ Behavior Driven Development example and testing framework.
```

## br2-foundationsos-external/package/applications/gpio/Config.in
```kconfig
config BR2_PACKAGE_GPIO
	bool "gpio"
	help
	  GPIO control and manipulation example application.
```

## br2-foundationsos-external/package/applications/helloworld/Config.in
```kconfig
config BR2_PACKAGE_HELLOWORLD
	bool "helloworld"
	help
	  Simple hello world example application.
```

## br2-foundationsos-external/package/applications/template-c/Config.in
```kconfig
config BR2_PACKAGE_TEMPLATE_C
	bool "template-c"
	help
	  C project template for FoundationOS applications.
```

## br2-foundationsos-external/package/applications/template-cpp/Config.in
```kconfig
config BR2_PACKAGE_TEMPLATE_CPP
	bool "template-cpp"
	help
	  C++ project template for FoundationOS applications.
```

## br2-foundationsos-external/package/applications/template-py/Config.in
```kconfig
config BR2_PACKAGE_TEMPLATE_PY
	bool "template-py"
	help
	  Python project template for FoundationOS applications.
```

## br2-foundationsos-external/package/applications/timer/Config.in
```kconfig
config BR2_PACKAGE_TIMER
	bool "timer"
	help
	  Timer application example for FoundationOS.
```

## br2-foundationsos-external/package/drivers/Config.in
```kconfig
comment "Kernel Space Drivers"

source "$BR2_EXTERNAL_FOUNDATIONSOS_PATH/package/drivers/kernel/Config.in"
source "$BR2_EXTERNAL_FOUNDATIONSOS_PATH/package/drivers/kernel-space/Config.in"

comment "User Space Drivers"

source "$BR2_EXTERNAL_FOUNDATIONSOS_PATH/package/drivers/user/Config.in"
source "$BR2_EXTERNAL_FOUNDATIONSOS_PATH/package/drivers/user-space/Config.in"
```

## br2-foundationsos-external/package/utils/Config.in
```kconfig
comment "System Utilities & Monitoring Tools"

source "$BR2_EXTERNAL_FOUNDATIONSOS_PATH/package/utils/atop2/Config.in"
source "$BR2_EXTERNAL_FOUNDATIONSOS_PATH/package/utils/btop/Config.in"

comment "System Configuration & Persistence"

source "$BR2_EXTERNAL_FOUNDATIONSOS_PATH/package/utils/netatop/Config.in"
source "$BR2_EXTERNAL_FOUNDATIONSOS_PATH/package/utils/persist-partition/Config.in"
source "$BR2_EXTERNAL_FOUNDATIONSOS_PATH/package/utils/home-persistence/Config.in"

comment "SSH & Security Tools"

source "$BR2_EXTERNAL_FOUNDATIONSOS_PATH/package/utils/ssh-root-password/Config.in"
source "$BR2_EXTERNAL_FOUNDATIONSOS_PATH/package/utils/ssh-key-persistence/Config.in"

comment "Testing & Development Tools"

source "$BR2_EXTERNAL_FOUNDATIONSOS_PATH/package/utils/cucumber-cpp/Config.in"
```
